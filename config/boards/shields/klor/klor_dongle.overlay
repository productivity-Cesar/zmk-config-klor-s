#include "klor-layouts.dtsi"

/ {
    chosen {
        zmk,physical_layout = &klor_saegewerk_layout;
    };

    default_transform: keymap_transform_0 {
        compatible = "zmk,matrix-transform";
        columns = <12>;
        rows = <4>;
        map = <
               2   3   4   5   6    7   8   9  10  11
             258 259 260 261 262  263 264 265 266 267
             514 515 516 517 518  519 520 521 522 523
                 769 770 771      776 777 778
        >;
    };
};

&klor_saegewerk_layout {
    transform = <&default_transform>;
};
